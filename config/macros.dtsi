/ {
    macros {
        // To be used with the UNMASKED mod morph
        macro_equal_arrow: macro_equal_arrow {
            label = "macro_equal_arrow";
            compatible = "zmk,behavior-macro";
            wait-ms = <0>;
            tap-ms = <0>;
            #binding-cells = <0>;
            bindings
                = <&macro_release &kp LSHFT>
                , <&macro_tap &kp EQUAL>
                , <&macro_press &kp LSHFT>
                , <&macro_tap &kp GREATER_THAN>
                , <&macro_release &kp LSHFT>
                ;
        };

        macro_space_osshift: macro_space_osshift {
            label = "macro_space_osshift";
            compatible = "zmk,behavior-macro";
            wait-ms = <0>;
            tap-ms = <0>;
            #binding-cells = <0>;
            bindings
                = <&macro_tap &kp SPACE>
                , <&macro_tap osqSHFT>
                ;
        };
    };
};